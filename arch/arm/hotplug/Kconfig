## arch/arm/hotplug/Kconfig
```kconfig
 config BLU_PLUG
     bool "Dynamic Hotplug driver"
     depends on HOTPLUG_CPU
	 depends on HAS_EARLYSUSPEND
     default n
     help
       The Dynamic hotplug driver automatically online/offline CPUs proportional to system load.
 
config BLU_PLUG_DEBUG
	bool "Dynamic Hotplug debug"
	depends on BLU_PLUG
```
